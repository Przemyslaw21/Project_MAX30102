## CMakeLists.txt
```
#
# Copyright (c) 2018 Nordic Semiconductor
#
# SPDX-License-Identifier: LicenseRef-Nordic-5-Clause
#
cmake_minimum_required(VERSION 3.20.0)

find_package(Zephyr REQUIRED HINTS $ENV{ZEPHYR_BASE})
project(NONE)

# NORDIC SDK APP START
target_sources(app PRIVATE
  src/main.c
)

# NORDIC SDK APP END
zephyr_library_include_directories(.)
zephyr_include_directories(src/max30102)
 
```

## prj.conf
```kconfig
#
# Copyright (c) 2018 Nordic Semiconductor
#
# SPDX-License-Identifier: LicenseRef-Nordic-5-Clause
#
CONFIG_NCS_SAMPLES_DEFAULTS=y

CONFIG_BT=y
CONFIG_BT_PERIPHERAL=y
CONFIG_BT_DEVICE_NAME="Nordic_LBS"

# Enable the LBS service
CONFIG_BT_LBS=y
CONFIG_BT_LBS_POLL_BUTTON=y
CONFIG_DK_LIBRARY=y

CONFIG_SYSTEM_WORKQUEUE_STACK_SIZE=2048

CONFIG_I2C=y
CONFIG_CBPRINTF_FP_A_SUPPORT=y
```

## src/main.c
```c
/*
 * Copyright (c) 2018 Nordic Semiconductor ASA
 *
 * SPDX-License-Identifier: LicenseRef-Nordic-5-Clause
 */

#include <zephyr/types.h>
#include <stddef.h>
#include <string.h>
#include <errno.h>
#include <zephyr/sys/printk.h>
#include <zephyr/sys/byteorder.h>
#include <zephyr/kernel.h>
#include <zephyr/drivers/gpio.h>
#include <soc.h>

// Things what i add
#include <stdio.h>
#include <math.h>
#include <max30102.h>
#include "algorithm.c"
#include <zephyr/drivers/i2c.h>
#include <zephyr/drivers/timer/system_timer.h>

typedef enum MAX30102_STATUS
{
	MAX30102_OK = 0,
	MAX30102_ERROR = 1
} MAX30102_STATUS;

typedef struct
{
	uint8_t IRQ_Status_Flags[1];
	uint8_t Temp_Reg;
	uint32_t Raw_HR_Data;
	bool Shootdown_STATUS;
	uint32_t Raw_Data_Red_LED;
	uint32_t Raw_Data_IR_LED;
	float Data_Temp;

} MAX30102_Data;

MAX30102_Data Data_HR;

#define I2C_NODE DT_NODELABEL(i2c0)
static const struct device *i2c0_dev = DEVICE_DT_GET(I2C_NODE);

MAX30102_STATUS MAX30102_Init(const struct device *i2c0_dev);
MAX30102_STATUS MAX30102_Read_Reg(const struct device *i2c0_dev, uint8_t reg_addr, uint8_t Tmp);
MAX30102_STATUS MAX30102_Write_Reg(const struct device *i2c0_dev, uint8_t Reg_Addr, uint8_t value);
MAX30102_STATUS MAX30102_Write_Reg_Bit(const struct device *i2c0_dev, uint8_t Register, uint8_t Bit, uint8_t Value);

MAX30102_STATUS MAX30102_Reset(const struct device *i2c0_dev);
MAX30102_STATUS MAX30102_Read_and_Clear_IRQ_FLAG(const struct device *i2c0_dev);
MAX30102_STATUS MAX30102_Set_Mode(uint8_t Mode);
MAX30102_STATUS MAX30102_Sleep_Mode(uint8_t Enable);

MAX30102_STATUS MAX30102_Read_Fifo(MAX30102_Data *data);
MAX30102_STATUS MAX30102_Fifo_Write_Pointer(uint16_t Value_to_write);
MAX30102_STATUS MAX30102_Fifo_Overflow_Counter(uint16_t Value_to_write);
MAX30102_STATUS MAX30102_Fifo_Read_Pointer(uint16_t Value_to_write);
MAX30102_STATUS MAX30102_Fifo_Sample_Averaging(uint16_t Value_to_write);
MAX30102_STATUS MAX30102_Fifo_Rollover_Enable(uint8_t Flag_to_write);
MAX30102_STATUS MAX30102_Fifo_Almost_Full_Value(uint8_t Value);

// SpO2
MAX30102_STATUS MAX30102_Adc_Range(uint8_t Value);
MAX30102_STATUS MAX30102_Sample_Rate(uint8_t Value);

// LED
MAX30102_STATUS MAX30102_LED_Pulse_Width(uint8_t Value);
MAX30102_STATUS MAX30102_LED_1_Pulse_Amplitude(uint16_t Value);
MAX30102_STATUS MAX30102_LED_2_Pulse_Amplitude(uint16_t Value);

// Temperature
MAX30102_STATUS MAX30102_Get_Temp(MAX30102_Data *data);
//_________________________

// Work_Callback
static void MAX30102_Work_Cb(struct k_work *work)
{
	MAX30102_Sleep_Mode(0);
	MAX30102_Init(i2c0_dev);
	MAX30102_Read_Fifo(&Data_HR);
	printk("Data RED LED: %u  IR LED: %u  TEMP: %.2f \n", Data_HR.Raw_Data_Red_LED, Data_HR.Raw_Data_IR_LED, Data_HR.Data_Temp);
	MAX30102_Sleep_Mode(1);
}

struct k_work MAX30102_Work;

// Timers
static void Timer0_CallBack(struct k_timer *dummy)
{
	k_work_submit(&MAX30102_Work);
};

struct k_timer timer0;

void main(void)
{

	k_work_init(&MAX30102_Work, MAX30102_Work_Cb);
	k_timer_init(&timer0, Timer0_CallBack, NULL); // NULL = stop function
	k_timer_start(&timer0, K_SECONDS(1), K_SECONDS(1));

	if (!device_is_ready(i2c0_dev))

	{
		printk("DEVICE IS NOT READY");
	}

	MAX30102_Init(i2c0_dev);

	while (1)
	{
		// k_msleep(SYS_TIME_SLEEP_MS);
		// MAX30102_Read_Fifo(&Data_HR);
		// MAX30102_Get_Temp(&Data_HR);
	}

	// maxim_heart_rate_and_oxygen_saturation(Data_HR.Raw_Data_IR_LED, Data_HR.Raw_Data_Red_LED);
}

MAX30102_STATUS MAX30102_Who_Im(const struct device *i2c0_dev)
{
	uint8_t RegToRead[1] = {0};
	if (0 != i2c_burst_read(i2c0_dev, MAX30102_ADDRESS, MAX30102_PARTID, RegToRead, 1))
	{
		printk("MAX30102 connected! Part ID: 0x%x\n", RegToRead[0]);
		return MAX30102_OK;
	}
	else
	{
		printk("MAX30102 disconnected!");

		if (RegToRead[0] != 0x15)
			printk("MAX30102 wrong ID! Part ID: %dd\n", RegToRead[0]);

		return MAX30102_ERROR;
	}
}
MAX30102_STATUS MAX30102_Init(const struct device *i2c0_dev) // Who Im?
{

#if RESET_DURING_INIT
	if (MAX30102_OK != MAX30102_Reset(i2c0_dev)) // resets the MAX30102
		return MAX30102_ERROR;
#endif

	// FIFO config
	if (MAX30102_OK != MAX30102_Fifo_Write_Pointer(0x00)) // PoR 0X00 default
		return MAX30102_ERROR;
	if (MAX30102_OK != MAX30102_Fifo_Overflow_Counter(0x00))
		return MAX30102_ERROR;
	if (MAX30102_OK != MAX30102_Fifo_Read_Pointer(0x00))
		return MAX30102_ERROR;
	if (MAX30102_OK != MAX30102_Fifo_Sample_Averaging(FIFO_SMP_AVE_1))
		return MAX30102_ERROR;
	if (MAX30102_OK != MAX30102_Fifo_Rollover_Enable(1))
		return MAX30102_ERROR;
	if (MAX30102_OK != MAX30102_Fifo_Almost_Full_Value(MAX30102_FIFO_ALMOST_FULL_SAMPLES))
		return MAX30102_ERROR;

	// Mode config
	if (MAX30102_OK != MAX30102_Set_Mode(MODE_SpO2))
		return MAX30102_ERROR;
	if (MAX30102_OK != MAX30102_Adc_Range(SPO2_ADC_RGE_4096))
		return MAX30102_ERROR;
	if (MAX30102_OK != MAX30102_Sample_Rate(MAX30102_SAMPLES_PER_SECOND))
		return MAX30102_ERROR;

	// LED Config
	if (MAX30102_OK != MAX30102_LED_Pulse_Width(PULSE_WIDTH_69))
		return MAX30102_ERROR;
	if (MAX30102_OK != MAX30102_LED_1_Pulse_Amplitude(IR_LED_CURRENT_HIGH))
		return MAX30102_ERROR;
	if (MAX30102_OK != MAX30102_LED_2_Pulse_Amplitude(RED_LED_CURRENT_HIGH))
		return MAX30102_ERROR;

	// Temp config
	// if (MAX30102_OK != MAX30102_Sample_Rate(MAX30102_SAMPLES_PER_SECOND))
	// 	return MAX30102_ERROR;
	// if (MAX30102_OK != MAX30102_Sample_Rate(MAX30102_SAMPLES_PER_SECOND))
	// 	return MAX30102_ERROR;

	// IRQ config
	//  if (MAX30102_OK != MAX30102_Set_IRQ_Almost_Full_Enabled(1))
	//  	return MAX30102_ERROR;
	//  if (MAX30102_OK != MAX30102_Set_IRQ_Fifo_Data_Ready_Enabled(1))
	//  return MAX30102_ERROR;

	return MAX30102_OK;
}
MAX30102_STATUS MAX30102_Read_Reg(const struct device *i2c0_dev, uint8_t reg_addr, uint8_t Tmp)
{
	int err;
	// uint8_t buf[1] = {0x00};

	err = i2c_burst_read(i2c0_dev, MAX30102_ADDRESS, reg_addr, &Tmp, 1);
	if (err)
	{
		printk("MAX30102: Error!\n");
		return MAX30102_ERROR;
	}
	else
	{
		// Tmp = buf[0];
		return MAX30102_OK;
	}
}
MAX30102_STATUS MAX30102_Write_Reg(const struct device *i2c0_dev, uint8_t Reg_Addr, uint8_t value)
{
	int err = i2c_burst_write(i2c0_dev, MAX30102_ADDRESS, Reg_Addr, &value, 1);
	if (err)
	{
		printk("MAX30102: Error!\n");
		return MAX30102_ERROR;
	}
	else
	{
		return MAX30102_OK;
	}
}
MAX30102_STATUS MAX30102_Write_Reg_Bit(const struct device *i2c0_dev, uint8_t Register, uint8_t Bit, uint8_t Value)
{
	uint8_t Tmp;
	if (MAX30102_OK != MAX30102_Read_Reg(i2c0_dev, Register, &Tmp))
		return MAX30102_ERROR;
	Tmp &= ~(1 << Bit);
	Tmp |= (Value & 0x01) << Bit;
	if (MAX30102_OK != MAX30102_Write_Reg(i2c0_dev, Register, Tmp))
		return MAX30102_ERROR;

	return MAX30102_OK;
}

MAX30102_STATUS MAX30102_Reset(const struct device *i2c0_dev) // Reset MAX30102
{
	uint8_t RegToWrite[1] = {MAX30102_RESET};
	uint8_t err = i2c_reg_write_byte(i2c0_dev, MAX30102_ADDRESS, MAX30102_MODE_CONFIG, RegToWrite[0]);

	if (err)
	{
		printk("Reset error!\n");
		return MAX30102_ERROR;
	}
	else
	{
		printk("Reset done!\n");
		return MAX30102_OK;
	}
}
MAX30102_STATUS MAX30102_Clear_IRQ_FLAG(const struct device *i2c0_dev, MAX30102_Data *data) // Reads the interrupt status registers, clearing is automaticly
{
	data->IRQ_Status_Flags[1] = 0x0;
	int err = i2c_burst_read(i2c0_dev, MAX30102_ADDRESS, MAX30102_IRQ_STATUS_1, data->IRQ_Status_Flags, 1);

	if (err)
	{
		printk("MAX30102: Interrupt Status 1: Error!\n");
		return MAX30102_ERROR;
	}
	else
	{
		printk("MAX30102: Interrupt Status 1: Ok (%d)\n", data->IRQ_Status_Flags[0]);
		return MAX30102_OK;
	}
}
MAX30102_STATUS MAX30102_Set_Mode(uint8_t Mode)
{
	uint8_t Tmp;
	if (MAX30102_OK != MAX30102_Read_Reg(i2c0_dev, MAX30102_MODE_CONFIG, &Tmp))
		return MAX30102_ERROR;
	Tmp &= ~(0x07);
	Tmp |= (Mode & 0x07);
	if (MAX30102_OK != MAX30102_Write_Reg(i2c0_dev, MAX30102_MODE_CONFIG, Tmp))
		return MAX30102_ERROR;

	return MAX30102_OK;
}
MAX30102_STATUS MAX30102_Sleep_Mode(uint8_t Enable) // POWER SAVE MODE
{
	uint8_t Tmp;
	;
	if (MAX30102_OK != MAX30102_Read_Reg(i2c0_dev, MAX30102_MODE_CONFIG, Tmp))
		return MAX30102_ERROR;

	if (Enable == 1)
	{
		Tmp |= 0x40;
		if (MAX30102_OK != MAX30102_Write_Reg(i2c0_dev, MAX30102_MODE_CONFIG, Tmp))
			return MAX30102_ERROR;
	}
	else if (Enable == 0)
	{
		Tmp |= 0x40;
		if (MAX30102_OK != MAX30102_Write_Reg(i2c0_dev, MAX30102_MODE_CONFIG, Tmp))
			return MAX30102_ERROR;
	}

	return MAX30102_OK;
}

// FIFO
MAX30102_STATUS MAX30102_Read_Fifo(MAX30102_Data *data)
{

	uint32_t Tmp;
	data->Raw_Data_Red_LED = 0;
	data->Raw_Data_IR_LED = 0;
	unsigned char Tmp_Buff_I2C[6];

#if OMIT_FIFO // USE FOR OMIT FIFO AND GET GOING SAMPLES
	if (MAX30102_OK != MAX30102_Fifo_Write_Pointer(0x00))
		return MAX30102_ERROR;
#endif

	if (0 != i2c_burst_read(i2c0_dev, MAX30102_ADDRESS, MAX30102_REG_FIFO_DATA, Tmp_Buff_I2C, 6))
	{
		printk("MAX30102: Error!\n");
		return MAX30102_ERROR;
	}
	Tmp = Tmp_Buff_I2C[0];
	Tmp <<= 16;
	data->Raw_Data_Red_LED += Tmp;
	Tmp = Tmp_Buff_I2C[1];
	Tmp <<= 8;
	data->Raw_Data_Red_LED += Tmp;
	Tmp = Tmp_Buff_I2C[2];
	data->Raw_Data_Red_LED += Tmp;

	Tmp = Tmp_Buff_I2C[3];
	Tmp <<= 16;
	data->Raw_Data_IR_LED += Tmp;
	Tmp = Tmp_Buff_I2C[4];
	Tmp <<= 8;
	data->Raw_Data_IR_LED += Tmp;
	Tmp = Tmp_Buff_I2C[5];
	data->Raw_Data_IR_LED += Tmp;

	data->Raw_Data_Red_LED &= 0x03FFFF;
	data->Raw_Data_IR_LED &= 0x03FFFF;

	return MAX30102_OK;
}
MAX30102_STATUS MAX30102_Fifo_Write_Pointer(uint16_t Value)
{
	return MAX30102_Write_Reg(i2c0_dev, MAX30102_FIFO_WRITE_PTR, (Value & 0x1F)); // FIFO_WR_PTR[4:0]
}
MAX30102_STATUS MAX30102_Fifo_Overflow_Counter(uint16_t Value)
{
	return MAX30102_Write_Reg(i2c0_dev, MAX30102_OVERFLOW_COUNT, (Value & 0x1F)); // FIFO_WR_PTR[4:0]
}
MAX30102_STATUS MAX30102_Fifo_Read_Pointer(uint16_t Value)
{
	return MAX30102_Write_Reg(i2c0_dev, MAX30102_FIFO_READ_PTR, (Value & 0x1F)); // FIFO_WR_PTR[4:0]
};
MAX30102_STATUS MAX30102_Fifo_Sample_Averaging(uint16_t Value)
{
	uint8_t Tmp;
	MAX30102_Read_Reg(i2c0_dev, MAX30102_FIFO_CONFIG, &Tmp);

	Tmp &= ~(0x07);
	Tmp |= (Value & 0x07) << 5;
	return MAX30102_Write_Reg(i2c0_dev, MAX30102_FIFO_CONFIG, &Tmp);
}
MAX30102_STATUS MAX30102_Fifo_Rollover_Enable(uint8_t Flag)
{
	// ON = 1
	// OFF = 0
	return MAX30102_Write_Reg_Bit(i2c0_dev, MAX30102_FIFO_CONFIG, FIFO_CONF_FIFO_ROLLOVER_EN_BIT, (Flag & 0x01));
}
MAX30102_STATUS MAX30102_Fifo_Almost_Full_Value(uint8_t Value)
{
	if (Value < 17)
		Value = 17;
	if (Value > 32)
		Value = 32;
	Value = 32 - Value;
	uint8_t Tmp;
	if (MAX30102_OK != MAX30102_Read_Reg(i2c0_dev, MAX30102_FIFO_CONFIG, &Tmp))
		return MAX30102_ERROR;
	Tmp &= ~(0x0F);
	Tmp |= (Value & 0x0F);
	if (MAX30102_OK != MAX30102_Write_Reg(i2c0_dev, MAX30102_FIFO_CONFIG, Tmp))
		return MAX30102_ERROR;

	return MAX30102_OK;
}

MAX30102_STATUS MAX30102_Adc_Range(uint8_t Value)
{
	uint8_t tmp;
	if (MAX30102_OK != MAX30102_Read_Reg(i2c0_dev, MAX30102_SPO2_CONFIG, &tmp))
		return MAX30102_ERROR;
	tmp &= ~(0x03);
	tmp |= ((Value & 0x03) << 5);
	if (MAX30102_OK != MAX30102_Write_Reg(i2c0_dev, MAX30102_SPO2_CONFIG, Value))
		return MAX30102_ERROR;

	return MAX30102_OK;
}
MAX30102_STATUS MAX30102_Sample_Rate(uint8_t Value)
{
	uint8_t tmp;
	if (MAX30102_OK != MAX30102_Read_Reg(i2c0_dev, MAX30102_SPO2_CONFIG, &tmp))
		return MAX30102_ERROR;
	tmp &= ~(0x07);
	tmp |= ((Value & 0x07) << 2);
	if (MAX30102_OK != MAX30102_Write_Reg(i2c0_dev, MAX30102_SPO2_CONFIG, Value))
		return MAX30102_ERROR;

	return MAX30102_OK;
}
MAX30102_STATUS MAX30102_LED_Pulse_Width(uint8_t Value)
{
	uint8_t tmp;
	if (MAX30102_OK != MAX30102_Read_Reg(i2c0_dev, MAX30102_SPO2_CONFIG, &tmp))
		return MAX30102_ERROR;
	tmp &= ~(0x03);
	tmp |= (Value & 0x03);
	if (MAX30102_OK != MAX30102_Write_Reg(i2c0_dev, MAX30102_SPO2_CONFIG, Value))
		return MAX30102_ERROR;

	return MAX30102_OK;
}
MAX30102_STATUS MAX30102_LED_1_Pulse_Amplitude(uint16_t Value) //	LED Current = Value * 0.2 mA
{
	if (MAX30102_OK != MAX30102_Write_Reg(i2c0_dev, MAX30102_LED1_PULSE_AMPLITUDE, Value))
		return MAX30102_ERROR;
	return MAX30102_OK;
}
MAX30102_STATUS MAX30102_LED_2_Pulse_Amplitude(uint16_t Value) //	LED Current = Value * 0.2 mA
{
	if (MAX30102_OK != MAX30102_Write_Reg(i2c0_dev, MAX30102_LED2_PULSE_AMPLITUDE, Value))
		return MAX30102_ERROR;
	return MAX30102_OK;
}

MAX30102_STATUS MAX30102_Get_Temp(MAX30102_Data *data) // nie czyta rejestru
{
	uint16_t Tmp_Integer;
	uint16_t Tmp_Fraction;
	// MAX30102_Temp_Init_Conversion();
	MAX30102_Write_Reg_Bit(i2c0_dev, TEMP_ENABLE, 0, 1);
	MAX30102_Read_Reg(i2c0_dev, TEMP_INTEGER, Tmp_Integer);
	MAX30102_Read_Reg(i2c0_dev, TEMP_FRACTION, Tmp_Fraction);
	Tmp_Fraction = Tmp_Fraction * TEMP_FRACTION_STEP;
	data->Data_Temp = (Tmp_Integer + Tmp_Fraction);
	return MAX30102_OK;
}

// Timer
```

## src/algorithm.c
```c
/*
 * File:   algorithm.c
 * Author: MKA
 *
 * Created on December 30, 2020, 6:17 AM
 */


/** \file algorithm.cpp ******************************************************
*
* Project: MAXREFDES117#
* Filename: algorithm.cpp
* Description: This module calculates the heart rate/SpO2 level
*
*
* --------------------------------------------------------------------
*
* This code follows the following naming conventions:
*
* char              ch_pmod_value
* char (array)      s_pmod_s_string[16]
* float             f_pmod_value
* int32_t           n_pmod_value
* int32_t (array)   an_pmod_value[16]
* int16_t           w_pmod_value
* int16_t (array)   aw_pmod_value[16]
* uint16_t          uw_pmod_value
* uint16_t (array)  auw_pmod_value[16]
* uint8_t           uch_pmod_value
* uint8_t (array)   auch_pmod_buffer[16]
* uint32_t          un_pmod_value
* int32_t *         pn_pmod_value
*
* ------------------------------------------------------------------------- */
/*******************************************************************************
* Copyright (C) 2016 Maxim Integrated Products, Inc., All Rights Reserved.
*
* Permission is hereby granted, free of charge, to any person obtaining a
* copy of this software and associated documentation files (the "Software"),
* to deal in the Software without restriction, including without limitation
* the rights to use, copy, modify, merge, publish, distribute, sublicense,
* and/or sell copies of the Software, and to permit persons to whom the
* Software is furnished to do so, subject to the following conditions:
*
* The above copyright notice and this permission notice shall be included
* in all copies or substantial portions of the Software.
*
* THE SOFTWARE IS PROVIDED "AS IS", WITHOUT WARRANTY OF ANY KIND, EXPRESS
* OR IMPLIED, INCLUDING BUT NOT LIMITED TO THE WARRANTIES OF
* MERCHANTABILITY, FITNESS FOR A PARTICULAR PURPOSE AND NONINFRINGEMENT.
* IN NO EVENT SHALL MAXIM INTEGRATED BE LIABLE FOR ANY CLAIM, DAMAGES
* OR OTHER LIABILITY, WHETHER IN AN ACTION OF CONTRACT, TORT OR OTHERWISE,
* ARISING FROM, OUT OF OR IN CONNECTION WITH THE SOFTWARE OR THE USE OR
* OTHER DEALINGS IN THE SOFTWARE.
*
* Except as contained in this notice, the name of Maxim Integrated
* Products, Inc. shall not be used except as stated in the Maxim Integrated
* Products, Inc. Branding Policy.
*
* The mere transfer of this software does not imply any licenses
* of trade secrets, proprietary technology, copyrights, patents,
* trademarks, maskwork rights, or any other form of intellectual
* property whatsoever. Maxim Integrated Products, Inc. retains all
* ownership rights.
*******************************************************************************
*/


#define FreqS 25    //sampling frequency
#define BUFFER_SIZE (FreqS * 4) 
#define MA4_SIZE 4 // DONOT CHANGE
#define min(x,y) ((x) < (y) ? (x) : (y)) //Defined in Arduino.h

//uch_spo2_table is approximated as  -45.060*ratioAverage* ratioAverage + 30.354 *ratioAverage + 94.845 ;
const uint8_t uch_spo2_table[184]={ 95, 95, 95, 96, 96, 96, 97, 97, 97, 97, 97, 98, 98, 98, 98, 98, 99, 99, 99, 99, 
              99, 99, 99, 99, 100, 100, 100, 100, 100, 100, 100, 100, 100, 100, 100, 100, 100, 100, 100, 100, 
              100, 100, 100, 100, 99, 99, 99, 99, 99, 99, 99, 99, 98, 98, 98, 98, 98, 98, 97, 97, 
              97, 97, 96, 96, 96, 96, 95, 95, 95, 94, 94, 94, 93, 93, 93, 92, 92, 92, 91, 91, 
              90, 90, 89, 89, 89, 88, 88, 87, 87, 86, 86, 85, 85, 84, 84, 83, 82, 82, 81, 81, 
              80, 80, 79, 78, 78, 77, 76, 76, 75, 74, 74, 73, 72, 72, 71, 70, 69, 69, 68, 67, 
              66, 66, 65, 64, 63, 62, 62, 61, 60, 59, 58, 57, 56, 56, 55, 54, 53, 52, 51, 50, 
              49, 48, 47, 46, 45, 44, 43, 42, 41, 40, 39, 38, 37, 36, 35, 34, 33, 31, 30, 29, 
              28, 27, 26, 25, 23, 22, 21, 20, 19, 17, 16, 15, 14, 12, 11, 10, 9, 7, 6, 5, 
              3, 2, 1 } ;
static  int32_t an_x[ BUFFER_SIZE]; //ir
static  int32_t an_y[ BUFFER_SIZE]; //red



void maxim_heart_rate_and_oxygen_saturation(uint32_t *pun_ir_buffer, int32_t n_ir_buffer_length, uint32_t *pun_red_buffer, int32_t *pn_spo2, int8_t *pch_spo2_valid, int32_t *pn_heart_rate, int8_t *pch_hr_valid);

//void maxim_heart_rate_and_oxygen_saturation(uint32_t *pun_ir_buffer, int32_t n_ir_buffer_length, uint32_t *pun_red_buffer);

void maxim_find_peaks(int32_t *pn_locs, int32_t *n_npks,  int32_t  *pn_x, int32_t n_size, int32_t n_min_height, int32_t n_min_distance, int32_t n_max_num);
void maxim_peaks_above_min_height(int32_t *pn_locs, int32_t *n_npks,  int32_t  *pn_x, int32_t n_size, int32_t n_min_height);
void maxim_remove_close_peaks(int32_t *pn_locs, int32_t *pn_npks, int32_t *pn_x, int32_t n_min_distance);
void maxim_sort_ascend(int32_t  *pn_x, int32_t n_size);
void maxim_sort_indices_descend(int32_t  *pn_x, int32_t *pn_indx, int32_t n_size);


void maxim_heart_rate_and_oxygen_saturation(uint32_t *pun_ir_buffer, int32_t n_ir_buffer_length, uint32_t *pun_red_buffer, int32_t *pn_spo2, int8_t *pch_spo2_valid, int32_t *pn_heart_rate, int8_t *pch_hr_valid)
/**
* \brief        Calculate the heart rate and SpO2 level
* \par          Details
*               By detecting  peaks of PPG cycle and corresponding AC/DC of red/infra-red signal, the an_ratio for the SPO2 is computed.
*               Since this algorithm is aiming for Arm M0/M3. formaula for SPO2 did not achieve the accuracy due to register overflow.
*               Thus, accurate SPO2 is precalculated and save longo uch_spo2_table[] per each an_ratio.
*
* \param[in]    *pun_ir_buffer           - IR sensor data buffer
* \param[in]    n_ir_buffer_length      - IR sensor data buffer length
* \param[in]    *pun_red_buffer          - Red sensor data buffer
* \param[out]    *pn_spo2                - Calculated SpO2 value
* \param[out]    *pch_spo2_valid         - 1 if the calculated SpO2 value is valid
* \param[out]    *pn_heart_rate          - Calculated heart rate value
* \param[out]    *pch_hr_valid           - 1 if the calculated heart rate value is valid
*
* \retval       None
*/
{
    
  uint32_t un_ir_mean;
  int32_t k, n_i_ratio_count;
  int32_t i, n_exact_ir_valley_locs_count, n_middle_idx;
  int32_t n_th1, n_npks;   
  int32_t an_ir_valley_locs[15] ;
  int32_t n_peak_interval_sum;
  
  int32_t n_y_ac, n_x_ac;
  int32_t n_spo2_calc; 
  int32_t n_y_dc_max, n_x_dc_max; 
  int32_t n_y_dc_max_idx = 0;
  int32_t n_x_dc_max_idx = 0; 
  int32_t an_ratio[5], n_ratio_average; 
  int32_t n_nume, n_denom ;

  // calculates DC mean and subtract DC from ir
  un_ir_mean =0; 
  for (k=0 ; k<n_ir_buffer_length ; k++ ) un_ir_mean += pun_ir_buffer[k] ;
  un_ir_mean =un_ir_mean/n_ir_buffer_length ;
    
  // remove DC and invert signal so that we can use peak detector as valley detector
  for (k=0 ; k<n_ir_buffer_length ; k++ )  
    an_x[k] = -1*(pun_ir_buffer[k] - un_ir_mean) ; 
    
  // 4 pt Moving Average
  for(k=0; k< BUFFER_SIZE-MA4_SIZE; k++){
    an_x[k]=( an_x[k]+an_x[k+1]+ an_x[k+2]+ an_x[k+3])/(int32_t)4;        
  }
  // calculate threshold  
  n_th1=0; 
  for ( k=0 ; k<BUFFER_SIZE ;k++){
    n_th1 +=  an_x[k];
  }
  n_th1=  n_th1/ ( BUFFER_SIZE);
  if( n_th1<30) n_th1=30; // min allowed
  if( n_th1>60) n_th1=60; // max allowed

  for ( k=0 ; k<15;k++) an_ir_valley_locs[k]=0;
  // since we flipped signal, we use peak detector as valley detector
  maxim_find_peaks( an_ir_valley_locs, &n_npks, an_x, BUFFER_SIZE, n_th1, 4, 15 );//peak_height, peak_distance, max_num_peaks 
  n_peak_interval_sum =0;
  if (n_npks>=2){
    for (k=1; k<n_npks; k++) n_peak_interval_sum += (an_ir_valley_locs[k] -an_ir_valley_locs[k -1] ) ;
    n_peak_interval_sum =n_peak_interval_sum/(n_npks-1);
    *pn_heart_rate =(int32_t)( (FreqS*60)/ n_peak_interval_sum );
    *pch_hr_valid  = 1;
  }
  else  { 
    *pn_heart_rate = -999; // unable to calculate because # of peaks are too small
    *pch_hr_valid  = 0;
  }

  //  load raw value again for SPO2 calculation : RED(=y) and IR(=X)
  for (k=0 ; k<n_ir_buffer_length ; k++ )  {
      an_x[k] =  pun_ir_buffer[k] ; 
      an_y[k] =  pun_red_buffer[k] ; 
  }

  // find precise min near an_ir_valley_locs
  n_exact_ir_valley_locs_count =n_npks; 
  
  //using exact_ir_valley_locs , find ir-red DC andir-red AC for SPO2 calibration an_ratio
  //finding AC/DC maximum of raw

  n_ratio_average =0; 
  n_i_ratio_count = 0; 
  for(k=0; k< 5; k++) an_ratio[k]=0;
  for (k=0; k< n_exact_ir_valley_locs_count; k++){
    if (an_ir_valley_locs[k] > BUFFER_SIZE ){
      *pn_spo2 =  -999 ; // do not use SPO2 since valley loc is out of range
      *pch_spo2_valid  = 0; 
      return;
    }
  }
  // find max between two valley locations 
  // and use an_ratio betwen AC compoent of Ir & Red and DC compoent of Ir & Red for SPO2 
  for (k=0; k< n_exact_ir_valley_locs_count-1; k++){
    n_y_dc_max= -16777216 ; 
    n_x_dc_max= -16777216; 
    if (an_ir_valley_locs[k+1]-an_ir_valley_locs[k] >3){
        for (i=an_ir_valley_locs[k]; i< an_ir_valley_locs[k+1]; i++){
          if (an_x[i]> n_x_dc_max) {n_x_dc_max =an_x[i]; n_x_dc_max_idx=i;}
          if (an_y[i]> n_y_dc_max) {n_y_dc_max =an_y[i]; n_y_dc_max_idx=i;}
      }
      n_y_ac= (an_y[an_ir_valley_locs[k+1]] - an_y[an_ir_valley_locs[k] ] )*(n_y_dc_max_idx -an_ir_valley_locs[k]); //red
      n_y_ac=  an_y[an_ir_valley_locs[k]] + n_y_ac/ (an_ir_valley_locs[k+1] - an_ir_valley_locs[k])  ; 
      n_y_ac=  an_y[n_y_dc_max_idx] - n_y_ac;    // subracting linear DC compoenents from raw 
      n_x_ac= (an_x[an_ir_valley_locs[k+1]] - an_x[an_ir_valley_locs[k] ] )*(n_x_dc_max_idx -an_ir_valley_locs[k]); // ir
      n_x_ac=  an_x[an_ir_valley_locs[k]] + n_x_ac/ (an_ir_valley_locs[k+1] - an_ir_valley_locs[k]); 
      n_x_ac=  an_x[n_y_dc_max_idx] - n_x_ac;      // subracting linear DC compoenents from raw 
      n_nume=( n_y_ac *n_x_dc_max)>>7 ; //prepare X100 to preserve floating value
      n_denom= ( n_x_ac *n_y_dc_max)>>7;
      if (n_denom>0  && n_i_ratio_count <5 &&  n_nume != 0)
      {   
        an_ratio[n_i_ratio_count]= (n_nume*100)/n_denom ; //formular is ( n_y_ac *n_x_dc_max) / ( n_x_ac *n_y_dc_max) ;
        n_i_ratio_count++;
      }
    }
  }
  // choose median value since PPG signal may varies from beat to beat
  maxim_sort_ascend(an_ratio, n_i_ratio_count);
  n_middle_idx= n_i_ratio_count/2;

  if (n_middle_idx >1)
    n_ratio_average =( an_ratio[n_middle_idx-1] +an_ratio[n_middle_idx])/2; // use median
  else
    n_ratio_average = an_ratio[n_middle_idx ];

  if( n_ratio_average>2 && n_ratio_average <184){
    n_spo2_calc= uch_spo2_table[n_ratio_average] ;
    *pn_spo2 = n_spo2_calc ;
    *pch_spo2_valid  = 1;//  float_SPO2 =  -45.060*n_ratio_average* n_ratio_average/10000 + 30.354 *n_ratio_average/100 + 94.845 ;  // for comparison with table
  }
  else{
    *pn_spo2 =  -999 ; // do not use SPO2 since signal an_ratio is out of range
    *pch_spo2_valid  = 0; 
  }
}


void maxim_find_peaks( int32_t *pn_locs, int32_t *n_npks,  int32_t  *pn_x, int32_t n_size, int32_t n_min_height, int32_t n_min_distance, int32_t n_max_num )
/**
* \brief        Find peaks
* \par          Details
*               Find at most MAX_NUM peaks above MIN_HEIGHT separated by at least MIN_DISTANCE
*
* \retval       None
*/
{
  maxim_peaks_above_min_height( pn_locs, n_npks, pn_x, n_size, n_min_height );
  maxim_remove_close_peaks( pn_locs, n_npks, pn_x, n_min_distance );
  *n_npks = min( *n_npks, n_max_num );
}

void maxim_peaks_above_min_height( int32_t *pn_locs, int32_t *n_npks,  int32_t  *pn_x, int32_t n_size, int32_t n_min_height )
/**
* \brief        Find peaks above n_min_height
* \par          Details
*               Find all peaks above MIN_HEIGHT
*
* \retval       None
*/
{
  int32_t i = 1, n_width;
  *n_npks = 0;
  
  while (i < n_size-1){
    if (pn_x[i] > n_min_height && pn_x[i] > pn_x[i-1]){      // find left edge of potential peaks
      n_width = 1;
      while (i+n_width < n_size && pn_x[i] == pn_x[i+n_width])  // find flat peaks
        n_width++;
      if (pn_x[i] > pn_x[i+n_width] && (*n_npks) < 15 ){      // find right edge of peaks
        pn_locs[(*n_npks)++] = i;    
        // for flat peaks, peak location is left edge
        i += n_width+1;
      }
      else
        i += n_width;
    }
    else
      i++;
  }
}

void maxim_remove_close_peaks(int32_t *pn_locs, int32_t *pn_npks, int32_t *pn_x, int32_t n_min_distance)
/**
* \brief        Remove peaks
* \par          Details
*               Remove peaks separated by less than MIN_DISTANCE
*
* \retval       None
*/
{
    
  int32_t i, j, n_old_npks, n_dist;
    
  /* Order peaks from large to small */
  maxim_sort_indices_descend( pn_x, pn_locs, *pn_npks );

  for ( i = -1; i < *pn_npks; i++ ){
    n_old_npks = *pn_npks;
    *pn_npks = i+1;
    for ( j = i+1; j < n_old_npks; j++ ){
      n_dist =  pn_locs[j] - ( i == -1 ? -1 : pn_locs[i] ); // lag-zero peak of autocorr is at index -1
      if ( n_dist > n_min_distance || n_dist < -n_min_distance )
        pn_locs[(*pn_npks)++] = pn_locs[j];
    }
  }

  // Resort indices int32_to ascending order
  maxim_sort_ascend( pn_locs, *pn_npks );
}

void maxim_sort_ascend(int32_t  *pn_x, int32_t n_size) 
/**
* \brief        Sort array
* \par          Details
*               Sort array in ascending order (insertion sort algorithm)
*
* \retval       None
*/
{
  int32_t i, j, n_temp;
  for (i = 1; i < n_size; i++) {
    n_temp = pn_x[i];
    for (j = i; j > 0 && n_temp < pn_x[j-1]; j--)
        pn_x[j] = pn_x[j-1];
    pn_x[j] = n_temp;
  }
}

void maxim_sort_indices_descend(  int32_t  *pn_x, int32_t *pn_indx, int32_t n_size)
/**
* \brief        Sort indices
* \par          Details
*               Sort indices according to descending order (insertion sort algorithm)
*
* \retval       None
*/ 
{
  int32_t i, j, n_temp;
  for (i = 1; i < n_size; i++) {
    n_temp = pn_indx[i];
    for (j = i; j > 0 && pn_x[n_temp] > pn_x[pn_indx[j-1]]; j--)
      pn_indx[j] = pn_indx[j-1];
    pn_indx[j] = n_temp;
  }
}
```
